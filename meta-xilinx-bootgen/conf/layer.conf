## meta-xilinx-bootgen/conf/layer.conf
```bitbake
# We have a conf and classes directory, add to BBPATH
BBPATH .= ":${LAYERDIR}"

# # We have recipes-* directories, add to BBFILES
BBFILES += "${LAYERDIR}/recipes-*/*/*.bb \
            ${LAYERDIR}/recipes-*/*/*.bbappend"

BBFILE_COLLECTIONS += "xilinx-bootgen"
BBFILE_PATTERN_xilinx-bootgen = "^${LAYERDIR}/"
BBFILE_PRIORITY_xilinx-bootgen = "5"
LAYERVERSION_xilinx-bootgen = "1"
LAYERSERIES_COMPAT_xilinx-bootgen = "dunfell"

INHIBIT_PACKAGE_STRIP="1"
#https://github.com/Xilinx/bootgen
```
